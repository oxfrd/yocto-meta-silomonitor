## conf/layer.conf
```bitbake
# We have a conf and classes directory, add to BBPATH
BBPATH .= ":${LAYERDIR}"

# We have recipes-* directories, add to BBFILES
BBFILES += "${LAYERDIR}/recipes-*/*/*.bb \
            ${LAYERDIR}/recipes-*/*/*.bbappend"

BBFILE_COLLECTIONS += "meta-silomonitor"
BBFILE_PATTERN_meta-silomonitor = "^${LAYERDIR}/"
BBFILE_PRIORITY_meta-silomonitor = "6"

LAYERDEPENDS_meta-silomonitor = "core"
LAYERSERIES_COMPAT_meta-silomonitor = "scarthgap"
```
